## tests/framework/application/testcase.yaml
```yaml
common:
  platform_allow:
    - native_sim/native/64
  integration_platforms:
    - native_sim/native/64
  tags:
    - controller
    - framework
tests:
  controller.framework.native_sim.application:
    timeout: 900
    harness: console
    harness_config:
      type: multi_line
      ordered: true
      # Only lines whose order the code fixes: a line of the fixture's threads and a line of the
      # supervisor can come in either order, so at most one of them is listed between two fixed ones.
      regex:
        # Boot 1: the contract (criteria 4, 5, 6, 8, 21, 23 and 34).
        - "application scenario boot 1"
        - "application scenario: a descriptor without safe_state is refused"
        - "init channels=0,0 status=0 parameter=0,.*,0 root=3 file=hello.txt written"
        - "application init result=0 channels=2 state=initialised"
        - "phase app init ok"
        - "phase web management ok"
        - "start prerequisites healthy: storage=healthy configuration=healthy"
        - "phase start prerequisites ok"
        - "start: worker and monitor threads created with Zephyr"
        - "application started state=running"
        - "phase application ok"
        - "startup supervision ended in step 12 application state=running"
        - "application scenario: a second start is refused"
        - "application scenario: controller operational, application running"
        - "application scenario: the status service shows fixture.counter"
        - "application scenario: the configuration service shows fixture.period"
        - "application scenario: route sweep routes=[0-9]+ refused=[0-9]+ public=[0-9]+"
        - "stop reason=operator"
        - "stop: both threads ended"
        - "application stopped state=stopped"
        - "application scenario: operator stop: stop, then safe state, controller operational"
        - "start: worker and monitor threads created with Zephyr"
        - "application started by an operator state=running"
        - "application scenario: operator start: started again without init"
        - "runtime dependency configuration health=failed"
        - "application scenario: runtime dependency failed: controller degraded, application running"
        - "runtime dependency configuration health=healthy"
        - "application scenario: runtime dependency recovered: controller operational"
        - "worker reports a fault"
        - "application reported a fault: stopping it"
        - "stop reason=fault"
        - "application fault: stopped and released state=fault"
        - "application scenario: reported fault: stop, then safe state, controller operational"
        - "application scenario: the status service shows the application in fault and its item released"
        - "application scenario: restart requested"
        # Boot 2: stop returns an error (criterion 8).
        - "application scenario boot 2"
        - "stop returns an error and ends nothing"
        - "application stop returned an error: a hang, feeding stops"
        - "application safe state requested by the supervisor"
        - "fault latched reason=stop name=app stop"
        - "Crux simulated watchdog expired"
        # Boot 3: the worker stops feeding (criterion 9).
        - "application scenario boot 3"
        - "last fault stop app stop"
        - "worker stops feeding its channel"
        - "application safe state requested by the supervisor"
        - "fault latched reason=channel name=worker"
        - "Crux simulated watchdog expired"
        # Boot 4: start passes its deadline (criterion 20).
        - "application scenario boot 4"
        - "last fault channel worker"
        - "application scenario: start will pass its deadline"
        - "start hangs"
        - "application safe state requested by the supervisor"
        - "fault latched reason=deadline name=application"
        - "Crux simulated watchdog expired"
        # Boot 5: stop passes its deadline (criterion 21).
        - "application scenario boot 5"
        - "last fault deadline application"
        - "stop hangs"
        - "application safe state requested by the supervisor"
        - "fault latched reason=deadline name=app stop"
        - "Crux simulated watchdog expired"
        # Boot 6: init fails after its registrations (criterion 8).
        - "application scenario boot 6"
        - "last fault deadline app stop"
        - "init fails after its registrations"
        - "application init result=-1 channels=0 state=fault"
        - "phase app init failed result=-1"
        - "application not started: state=fault"
        - "application scenario: init failed: safe state 1, controller operational"
        - "application scenario: device management answers"
        - "application scenario: restart requested"
        # Boot 7: the activation of the second channel is refused (criterion 22).
        - "application scenario boot 7"
        - "fault injection: channel monitor refused"
        - "application fault: activation or start failed state=fault"
        - "application scenario: activation refused: safe state 1, controller operational"
        - "application scenario: device management answers"
        - "application scenario: restart requested"
        # Boot 8: start returns an error (criterion 22).
        - "application scenario boot 8"
        - "start fails before it creates a thread"
        - "application fault: activation or start failed state=fault"
        - "application scenario: start failed: safe state 1, controller operational"
        - "application scenario: device management answers"
        - "application scenario: restart requested"
        # Boot 9: a start prerequisite fails at boot (criterion 23), then a planned reset.
        - "application scenario boot 9"
        - "start prerequisites not healthy: storage=healthy configuration=failed"
        - "application held reason=start prerequisite"
        - "startup supervision ended in step 12 application state=held"
        - "application scenario: held by a start prerequisite, controller degraded"
        - "application started by an operator state=running"
        - "application scenario: operator start ran the held application"
        - "application scenario: restart requested"
        - "planned reset: stopping the application"
        - "stop reason=planned reset"
        - "application stopped state=stopped"
        # Boot 10: a normal boot after the planned reset.
        - "application scenario boot 10"
        - "application scenario done"
```

## tests/framework/application_held/testcase.yaml
```yaml
common:
  platform_allow:
    - native_sim/native/64
  integration_platforms:
    - native_sim/native/64
  tags:
    - controller
    - framework
tests:
  controller.framework.native_sim.application_held:
    timeout: 300
    harness: console
    harness_config:
      type: multi_line
      ordered: true
      regex:
        - "held scenario start"
        - "watchdog not armed"
        - "application init result=0 channels=2 state=initialised"
        - "application held reason=watchdog not armed"
        - "startup supervision ended in step 12 application state=held"
        - "held scenario: initialised, not started, controller degraded"
```

## tests/framework/base/testcase.yaml
```yaml
common:
  platform_allow:
    - native_sim/native/64
  integration_platforms:
    - native_sim/native/64
  tags:
    - controller
    - framework
tests:
  controller.framework.native_sim.base:
    timeout: 180
```

## tests/framework/common/dts/bindings/vnd,retained-env.yaml
```yaml
# SPDX-License-Identifier: Apache-2.0

description: |
  Test-only retained memory for the native_sim scenarios of the controller framework. Its bytes
  live in an environment variable of the simulated process, which a restart through
  CONFIG_NATIVE_SIM_REBOOT keeps, so a retention area under it survives the restart as retained RAM
  survives a warm reset on a board. Not a model of any board.

compatible: "vnd,retained-env"

include: base.yaml

properties:
  size:
    type: int
    required: true
    description: Bytes of the area.

  "#address-cells":
    const: 1

  "#size-cells":
    const: 1
```

## tests/framework/no_watchdog/testcase.yaml
```yaml
common:
  platform_allow:
    - native_sim/native/64
  integration_platforms:
    - native_sim/native/64
  tags:
    - controller
    - framework
tests:
  controller.framework.native_sim.no_watchdog:
    timeout: 300
    harness: console
    harness_config:
      type: multi_line
      ordered: true
      regex:
        - "no watchdog scenario boot 1"
        - "boot class=power counter=0 threshold=3 safe mode=no retained region"
        - "watchdog not armed"
        - "fault injection: step application stalls"
        - "no watchdog scenario boot 2"
        - "reset cause=0x004 supported=0x005 captured, flags cleared"
        - "boot class=fault counter=1 threshold=3 safe mode=no retained region"
        - "last fault deadline application"
        - "controller state=operational"
        - "no watchdog scenario done"
```

## tests/framework/recovery/testcase.yaml
```yaml
common:
  platform_allow:
    - native_sim/native/64
  integration_platforms:
    - native_sim/native/64
  tags:
    - controller
    - framework
tests:
  controller.framework.native_sim.recovery:
    timeout: 600
    # Boot 2 injects a fatal error on purpose, and Zephyr prints its fatal error line.
    ignore_faults: true
    harness: console
    harness_config:
      type: multi_line
      ordered: true
      regex:
        - "recovery scenario boot 1"
        - "boot class=power counter=0 threshold=3 safe mode=no retained region"
        - "watchdog armed timeout=2000 ms"
        - "fault injection: step command line stalls"
        - "Crux simulated watchdog expired"
        - "recovery scenario boot 2"
        - "reset cause=0x004 supported=0x005 captured, flags cleared"
        - "boot class=fault counter=1 threshold=3 safe mode=no retained region"
        - "last fault deadline command line"
        - "recovery scenario boot 3"
        - "boot class=fault counter=2 threshold=3 safe mode=no retained region"
        - "last fault fatal supervisor"
        - "Crux simulated watchdog expired"
        - "recovery scenario boot 4"
        - "boot class=fault counter=3 threshold=3 safe mode=yes retained region"
        - "last fault channel time"
        - "phase time synchronisation left out: safe mode"
        - "no application: safe mode"
        - "Crux simulated watchdog expired"
        - "recovery scenario boot 5"
        - "boot class=fault counter=3 threshold=3 safe mode=yes retained region"
        - "last fault channel reboot"
        - "recovery scenario: status shows safe mode"
        - "safe mode exit requested by an operator"
        - "recovery scenario: restart requested"
        - "recovery scenario boot 6"
        - "boot class=normal counter=0 threshold=3 safe mode=no retained region"
        - "recovery scenario done"
```

## tests/framework/tls_refused/testcase.yaml
```yaml
common:
  platform_allow:
    - native_sim/native/64
  integration_platforms:
    - native_sim/native/64
  tags:
    - controller
    - framework
tests:
  controller.framework.native_sim.tls_refused:
    timeout: 300
    harness: console
    harness_config:
      type: multi_line
      ordered: true
      regex:
        - "tls scenario start"
        - "phase storage access ok"
        - "application init result=0 channels=2 state=initialised"
        - "tls certificate start refused result=-[0-9]+: web management stays off"
        - "phase web management failed result=-[0-9]+"
        - "serial command line started on crux-serial0"
        - "phase command line ok"
        - "start prerequisites healthy: configuration=healthy"
        - "application started state=running"
        - "startup supervision ended in step 12 application state=running"
        - "tls scenario: the wrapped start ran once"
        - "tls scenario: configuration, status and command line healthy, web failed"
        - "tls scenario: the reboot thread runs"
        - "tls scenario: no listener on port 443"
        - "tls scenario: controller operational, application running"
        - "tls scenario: the console made the first account"
        - "tls scenario: the status command shows web failed and the others healthy"
        - "tls scenario done"
```

## tests/native_sim/file/testcase.yaml
```yaml
common:
  platform_allow:
    - native_sim/native/64
  integration_platforms:
    - native_sim/native/64
  tags:
    - controller
    - file
tests:
  controller.file.native_sim.not_ready:
    extra_args: FILE_CASE=not_ready
  controller.file.native_sim.mounted_not_bound:
    extra_args: FILE_CASE=mounted_not_bound
  controller.file.native_sim.mount_failure:
    extra_args: FILE_CASE=mount_failure
  controller.file.native_sim.roundtrip:
    extra_args: FILE_CASE=roundtrip
  controller.file.native_sim.bind_failure:
    extra_args: FILE_CASE=bind_failure
```

## tests/native_sim/s5/testcase.yaml
```yaml
common:
  platform_allow:
    - native_sim/native/64
  tags:
    - controller
    - s5
tests:
  controller.s5.native_sim.first_sync:
    extra_args: S5_CASE=first_sync
  controller.s5.native_sim.kiss_of_death:
    extra_args: S5_CASE=kiss_of_death
  controller.s5.native_sim.late_answer:
    extra_args: S5_CASE=late_answer
  controller.s5.native_sim.out_of_range:
    extra_args: S5_CASE=out_of_range
  controller.s5.native_sim.step_refused_then_resync:
    extra_args: S5_CASE=step_refused_then_resync
  controller.s5.native_sim.correction_and_threshold:
    extra_args: S5_CASE=correction_and_threshold
  controller.s5.native_sim.stale_after_silence:
    extra_args: S5_CASE=stale_after_silence
```

## tests/native_sim/sntp/testcase.yaml
```yaml
common:
  platform_allow:
    - native_sim/native/64
  tags:
    - controller
    - sntp
tests:
  controller.sntp.native_sim.first_sync:
    extra_args: SNTP_CASE=first_sync
  controller.sntp.native_sim.kiss_of_death:
    extra_args: SNTP_CASE=kiss_of_death
  controller.sntp.native_sim.late_answer:
    extra_args: SNTP_CASE=late_answer
  controller.sntp.native_sim.out_of_range:
    extra_args: SNTP_CASE=out_of_range
  controller.sntp.native_sim.step_refused_then_resync:
    extra_args: SNTP_CASE=step_refused_then_resync
  controller.sntp.native_sim.correction_and_threshold:
    extra_args: SNTP_CASE=correction_and_threshold
  controller.sntp.native_sim.stale_after_silence:
    extra_args: SNTP_CASE=stale_after_silence
```

## tests/native_sim/system/testcase.yaml
```yaml
common:
  platform_allow:
    - native_sim/native/64
  tags:
    - controller
    - system
tests:
  controller.system.native_sim.reset_cause:
    extra_args: SYSTEM_CASE=reset_cause
  controller.system.native_sim.watchdog_unsupported:
    extra_args: SYSTEM_CASE=watchdog_unsupported
  controller.system.native_sim.period_out_of_range:
    extra_args: SYSTEM_CASE=period_out_of_range
```

## tests/native_sim/workload/testcase.yaml
```yaml
tests:
  controller.workload.native_sim:
    platform_allow:
      - native_sim/native/64
    tags:
      - controller
      - workload
```

## tests/native_sim_mbed/management/testcase.yaml
```yaml
common:
  platform_allow:
    - native_sim/native/64
  integration_platforms:
    - native_sim/native/64
  tags:
    - controller
    - management
tests:
  controller.management.native_sim.https_management:
    timeout: 180
```

## tests/native_sim_mbed/s6/testcase.yaml
```yaml
common:
  platform_allow:
    - native_sim/native/64
  tags:
    - controller
    - s6
tests:
  controller.s6.native_sim.https_management:
    timeout: 180
```
