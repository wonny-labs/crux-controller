## CMakeLists.txt
```
# SPDX-License-Identifier: Apache-2.0

cmake_minimum_required(VERSION 3.20.0)
find_package(Zephyr REQUIRED HINTS $ENV{ZEPHYR_BASE})

project(crux_controller)

target_sources(app PRIVATE src/main.c src/composition.c)
target_link_libraries(app PRIVATE crux::time)
target_compile_options(app PRIVATE -Wall -Wextra -Werror)

# Step S1 and later: the workload on Zephyr threads, a message queue and Crux Logging. Its
# portable core is a library of this repository, and the thread and queue calls are the source of
# the adapter zone (app/os), so the application takes no include path of its own and links neither
# Crux Thread nor Crux Queue. The switch is the product's own option, CRUX_CONTROLLER_S1.
if(CONFIG_CRUX_CONTROLLER_S1)
    add_subdirectory(../workload workload)
    add_subdirectory(os)
    target_sources(app PRIVATE src/workload_thread.c)
    target_link_libraries(app PRIVATE workload crux::logging)
    # Step S2: the TCP exchange, through the Crux Sockets profile.
    if(CONFIG_CRUX_CONTROLLER_S2)
        target_sources(app PRIVATE src/net_client.c)
        target_link_libraries(app PRIVATE crux::sockets crux::netif)
    endif()
    # Step S3: the configuration record in a file, through Crux File. The application uses
    # <crux/file.h> only. The composition zone is a library of its own, the only target that
    # links the File composition interface, so the application gets no include path to it.
    if(CONFIG_CRUX_CONTROLLER_S3)
        add_subdirectory(compose)
        target_sources(app PRIVATE src/config_store.c)
        target_link_libraries(app PRIVATE crux::file compose)
    endif()
    # Step S4: the reset cause and the watchdog, through <crux/system.h>. The glue and the policy
    # are sources of the application, and crux::system gives the public header only: the driver,
    # HWINFO and reboot facilities are inside Crux, so no zone and no include path is added here.
    if(CONFIG_CRUX_CONTROLLER_S4)
        target_sources(app PRIVATE src/health.c src/health_policy.c)
        target_link_libraries(app PRIVATE crux::system)
    endif()
endif()
```

## Kconfig
```
# SPDX-License-Identifier: Apache-2.0

config CRUX_CONTROLLER_S1
	bool "Step S1: the workload on Zephyr threads and a message queue"
	depends on MULTITHREADING
	# The adapter zone builds absolute deadlines (K_TIMEOUT_ABS_TICKS), which need 64-bit kernel
	# timeouts. Zephyr turns them on by default, and the Crux Thread and Queue providers selected
	# them while the workload called those providers. The product asks for them itself now.
	select TIMEOUT_64BIT
	help
	  Run the workload: a producer and a consumer thread joined by one message queue, created by
	  the adapter zone app/os with Zephyr kernel calls, reading Crux Time and reporting through
	  Crux Logging. Steps S2 and S3 build on this one. The product uses no Crux Thread, Sync or
	  Queue provider, so none is selected for it.

config CRUX_CONTROLLER_S2
	bool "Step S2: send each workload message to a TCP peer"
	depends on CRUX_CONTROLLER_S1 && CRUX_SOCKETS && CRUX_NETIF
	help
	  After a message is logged, open a TCP connection to the peer, send the message
	  and expect the same eight bytes back. The Sockets profile of Crux defines the
	  calls that are used. The exchange is built and never run in Stage 1 CI.

config CRUX_CONTROLLER_PEER_ADDRESS
	string "IPv4 address of the TCP peer"
	default "192.168.77.1"
	depends on CRUX_CONTROLLER_S2

config CRUX_CONTROLLER_PEER_PORT
	int "TCP port of the peer"
	default 42420
	range 1 65535
	depends on CRUX_CONTROLLER_S2

config CRUX_CONTROLLER_S3
	bool "Step S3: keep the workload configuration record in a file"
	depends on CRUX_CONTROLLER_S1 && CRUX_FILE_FATFS_RT1060
	help
	  At start, mount the microSD volume that the devicetree entry controller_storage
	  describes, bind its files directory to Crux File, load the configuration record from
	  the file config.rec and use it, or save the default record when none exists. The image
	  creates no directory and never formats a volume: the directory "files" must already
	  exist on the card, and a card without it leaves the default configuration in use, as
	  does a volume that does not mount. Built and never run in Stage 1 CI.

config CRUX_CONTROLLER_S4
	bool "Step S4: report the reset cause and feed a watchdog from the workload cycle"
	depends on CRUX_CONTROLLER_S1 && CRUX_SYSTEM && WATCHDOG && HWINFO && REBOOT
	help
	  At start, write one line for the reset cause through Crux Logging and clear the flags, then
	  start the one watchdog of the boot with an interval of about ten workload cycles and feed it
	  once for each pass that has cycles due, from the workload's producer thread and nowhere else. The
	  application uses <crux/system.h> only. The native watchdog, HWINFO and reboot facilities,
	  and the devicetree alias crux-watchdog0 (boards/s4.overlay), are what Crux System requires of
	  the image; the product selects no Crux symbol. A platform without a watchdog, such as the
	  native_sim simulator, reports it as not supported and the workload runs without one. A missed
	  feed ends in the watchdog's own reset; the product adds none. Built and never run on a board.

config CRUX_CONTROLLER_WORKER_STACK
	int "Stack bytes of each workload thread"
	default 4096
	range 1024 65536
	depends on CRUX_CONTROLLER_S1
	help
	  Each of the two workload threads has a stack of this size. The default is what the Crux
	  Thread provider gave the workload before it called Zephyr directly, and the S2 image sets
	  8192 because its exchange reaches into the network stack.

source "Kconfig.zephyr"
```

## prj.conf
```kconfig
CONFIG_STD_C17=y
CONFIG_CRUX_TIME=y
# west spdx needs this.
CONFIG_BUILD_OUTPUT_META=y
```

## boards/mimxrt1060_evk_mimxrt1062_qspi.overlay
```dts
/* Step S1: Crux Logging writes to LPUART1, and nothing else owns it. This is the
 * composition that crux-pilot documents for its Logging provider on this board. */
/ {
    chosen { zephyr,log-uart = &logging_uarts; };
    logging_uarts: logging-uarts {
        compatible = "zephyr,log-uart";
        uarts = <&lpuart1>;
    };
};

&lpuart1 {
    status = "okay";
    current-speed = <115200>;
    parity = "none";
};
```

## boards/s2.overlay
```dts
/* Step S2: the Ethernet composition of this board.
 *
 * Taken as a product-owned copy of the reference controller's network overlay in crux-pilot
 * (m3-network.overlay at the pinned revision), with another locally administered MAC address.
 * Used only by the S2 image, through EXTRA_DTC_OVERLAY_FILE. It is configuration, not code.
 */
/ {
    aliases {
        /delete-property/ led0;
    };
};

/* GPIO1.9 belongs exclusively to the PHY reset in this composition. */
/delete-node/ &green_led;

&enet_mac {
    /delete-property/ zephyr,random-mac-address;
    local-mac-address = [02 43 52 55 58 20];
};

/* Use the native 500 ms PHY monitor. */
&phy {
    /delete-property/ int-gpios;
};
```

## boards/s3.overlay
```dts
/* Step S3: the volume of the File composition, as a devicetree fstab entry.
 *
 * Zephyr's FatFs support declares the file system object and the mount description of every
 * "zephyr,fstab,fatfs" node, so the composition code needs neither the library header nor an
 * object of its own. The mount is not automatic: the composition mounts it, then binds File.
 * The mount point /SD: names the onboard microSD disk. The entry has no no-format flag, because
 * the binding does not support one: whether a volume is formatted is decided by
 * CONFIG_FS_FATFS_MOUNT_MKFS, which is off. Used only by the S3 image, through
 * EXTRA_DTC_OVERLAY_FILE. It is configuration, not code.
 */
/ {
    fstab {
        compatible = "zephyr,fstab";
        controller_storage: controller-storage {
            compatible = "zephyr,fstab,fatfs";
            mount-point = "/SD:";
            disk-access;
        };
    };
};
```

## boards/s4.overlay
```dts
/* Step S4: the watchdog that Crux System owns on this board.
 *
 * The provider takes no watchdog by default: the composition names it with the alias
 * crux-watchdog0, and components/system/ports/zephyr/system_binding.c requires that alias, that its
 * node is enabled and that it is the RT1060's WDOG1 (wdog0, 0x400b8000). Read at crux-pilot
 * 37c92b18: tests/system_consumer sets exactly these two lines for this board, and so do
 * tests/m5_integrated and tests/zephyr/management_rt1060_compile (target.overlay:3). The sample
 * samples/controller/zephyr/m3_main.c of that revision reads the alias watchdog0 instead, which is the
 * native watchdog owner that System refuses to coexist with, so it is not a model for this file.
 * Whether a later Crux revision changes the alias was not read. Used only by the S4 image, through
 * EXTRA_DTC_OVERLAY_FILE. It is configuration, not code.
 */
/ {
    aliases {
        crux-watchdog0 = &wdog0;
    };
};

&wdog0 {
    status = "okay";
};
```

## src/main.c
```c
/* SPDX-License-Identifier: Apache-2.0 */

#include <crux/status.h>
#include <crux/time.h>

/* The skeleton only proves that the build chain links a public Crux target.
 * Console output arrives with the Logging composition of step S1. */
int main(void)
{
    crux_monotonic_time_t now;

    return crux_monotonic_now(&now) == CRUX_OK ? 0 : -1;
}
```

## src/composition.c
```c
/* SPDX-License-Identifier: Apache-2.0 */

#include "composition.h"

#include <crux/status.h>
#include <crux/time.h>

#ifdef CONFIG_CRUX_CONTROLLER_S1
#include "workload.h"
#include "workload_thread.h"
#endif

#ifdef CONFIG_CRUX_CONTROLLER_S3
#include "config_store.h"
#include "storage_port.h"
#endif

#ifdef CONFIG_CRUX_CONTROLLER_S4
#include "health.h"
#endif

#ifdef CONFIG_CRUX_CONTROLLER_S2
#include <stdio.h>

#include <crux/logging.h>

#include "net_client.h"

/* S2: every logged message also goes to the peer. */
static void exchange_with_peer(const workload_message_t *message)
{
    char text[64];
    const int result = net_client_exchange(message);

    if (result == NET_CLIENT_OK) {
        (void)snprintf(text, sizeof text, "exchange ok cycle=%u", (unsigned)message->cycle);
        (void)crux_log_write(CRUX_LOG_INFO, "net", text);
    } else {
        (void)snprintf(text, sizeof text, "exchange failed cycle=%u result=%d",
                       (unsigned)message->cycle, result);
        (void)crux_log_write(CRUX_LOG_WARN, "net", text);
    }
}
#endif

#ifdef CONFIG_CRUX_CONTROLLER_S3
/* S3: the saved record replaces the default, and a first start saves the default. A volume that
 * does not mount or bind leaves the default in use, and the volume is never formatted. */
static void configure_from_storage(workload_config_t *config)
{
    workload_config_t saved;

    if (storage_port_mount(STORAGE_PORT_KEEP_VOLUME) != STORAGE_PORT_OK ||
        storage_port_bind() != STORAGE_PORT_OK) {
        return;
    }
    switch (config_store_load(&saved)) {
    case CONFIG_STORE_OK:
        *config = saved;
        break;
    case CONFIG_STORE_ERR_NOT_FOUND:
        (void)config_store_save(config);
        break;
    default:
        break;
    }
}
#endif

int composition_start(void)
{
    crux_monotonic_time_t now;

    /* S0: the clock answers. */
    const crux_status_t clock = crux_monotonic_now(&now);
    if (clock != CRUX_OK) {
        return clock;
    }
#ifdef CONFIG_CRUX_CONTROLLER_S1
    /* S1: the workload runs on Zephyr threads behind the product-owned port (the Zephyr calls are in
     * app/os) and reports through Crux Logging. */
    workload_config_t config;

    if (workload_config_default(&config) != WORKLOAD_OK) {
        return CRUX_ERR_INVALID_ARGUMENT;
    }
#ifdef CONFIG_CRUX_CONTROLLER_S3
    configure_from_storage(&config);
#endif
#ifdef CONFIG_CRUX_CONTROLLER_S4
    /* S4: say why the last run ended, then arm the watchdog for the configured cycle, after the
     * storage so that a slow mount cannot cost a reset. The producer feeds it once for each pass
     * that has cycles due. No watchdog runs only when the policy or Crux refuses the interval, or
     * there is no device; on any other error the native start may have been attempted, the
     * state is unknown, nothing feeds it and the watchdog may still reset the board. Either way
     * health.c reports it and the workload starts. */
    (void)health_report_reset_cause();
    (void)health_watchdog_start(config.period_ms);
    workload_thread_set_cycle_hook(health_cycle);
#endif
#ifdef CONFIG_CRUX_CONTROLLER_S2
    workload_thread_set_sink(exchange_with_peer);
#endif
    return workload_thread_start(&config);
#else
    return 0;
#endif
}
```

## src/composition.h
```c
/* SPDX-License-Identifier: Apache-2.0 */
#ifndef COMPOSITION_H
#define COMPOSITION_H

/* Start what this image's configuration selects. Returns 0, or a negative crux_status_t. */
int composition_start(void);

#endif
```

## src/config_store.c
```c
/* SPDX-License-Identifier: Apache-2.0 */

#include "config_store.h"

#include <stddef.h>
#include <stdint.h>

#include <crux/file.h>

static config_store_status_t status_of(crux_file_result_t result)
{
    switch (result) {
    case CRUX_FILE_OK:
        return CONFIG_STORE_OK;
    case CRUX_FILE_ERR_NOT_READY:
        return CONFIG_STORE_ERR_NOT_READY;
    case CRUX_FILE_ERR_NOT_FOUND:
        return CONFIG_STORE_ERR_NOT_FOUND;
    default:
        return CONFIG_STORE_ERR_IO;
    }
}

/* Write the whole record and flush it. A short write is an error here. */
static config_store_status_t write_and_sync(crux_file_t *file, const uint8_t *record, size_t length)
{
    size_t written = 0;
    const crux_file_result_t wrote = crux_file_write(file, record, length, &written);

    if (wrote == CRUX_FILE_OK && written == length) {
        return status_of(crux_file_sync(file));
    }
    if (wrote == CRUX_FILE_OK || wrote == CRUX_FILE_PARTIAL) {
        return CONFIG_STORE_ERR_IO;
    }
    return status_of(wrote);
}

/* Read up to capacity bytes. A file longer than the record shows as one byte too many. */
static config_store_status_t read_up_to(crux_file_t *file, uint8_t *buffer, size_t capacity,
                                        size_t *length)
{
    *length = 0;
    return status_of(crux_file_read(file, buffer, capacity, length));
}

config_store_status_t config_store_save(const workload_config_t *config)
{
    uint8_t record[WORKLOAD_CONFIG_RECORD_SIZE];
    size_t length = 0;
    crux_file_t *file = NULL;
    config_store_status_t status;
    crux_file_result_t opened;

    if (workload_config_encode(config, record, sizeof record, &length) != WORKLOAD_OK) {
        return CONFIG_STORE_ERR_RANGE;
    }
    opened = crux_file_open(CONFIG_STORE_FILE_NAME, CRUX_FILE_CREATE_REPLACE, &file);
    if (opened != CRUX_FILE_OK) {
        return status_of(opened);
    }
    status = write_and_sync(file, record, length);
    if (crux_file_close(&file) != CRUX_FILE_OK && status == CONFIG_STORE_OK) {
        status = CONFIG_STORE_ERR_IO;
    }
    return status;
}

config_store_status_t config_store_load(workload_config_t *config)
{
    uint8_t buffer[WORKLOAD_CONFIG_RECORD_SIZE + 1u];
    size_t length = 0;
    crux_file_t *file = NULL;
    config_store_status_t status;
    crux_file_result_t opened;

    if (config == NULL) {
        return CONFIG_STORE_ERR_RANGE;
    }
    opened = crux_file_open(CONFIG_STORE_FILE_NAME, CRUX_FILE_READ, &file);
    if (opened != CRUX_FILE_OK) {
        return status_of(opened);
    }
    status = read_up_to(file, buffer, sizeof buffer, &length);
    if (crux_file_close(&file) != CRUX_FILE_OK && status == CONFIG_STORE_OK) {
        status = CONFIG_STORE_ERR_IO;
    }
    if (status != CONFIG_STORE_OK) {
        return status;
    }
    return workload_config_decode(buffer, length, config) == WORKLOAD_OK ? CONFIG_STORE_OK
                                                                         : CONFIG_STORE_ERR_FORMAT;
}
```

## src/config_store.h
```c
/* SPDX-License-Identifier: Apache-2.0 */
#ifndef CONFIG_STORE_H
#define CONFIG_STORE_H

#include "workload.h"

/* The one file the store keeps in File's root. */
#define CONFIG_STORE_FILE_NAME "config.rec"

typedef enum {
    CONFIG_STORE_OK = 0,
    CONFIG_STORE_ERR_NOT_READY = -1, /* File is not bound yet */
    CONFIG_STORE_ERR_NOT_FOUND = -2, /* no record was saved */
    CONFIG_STORE_ERR_FORMAT = -3,    /* the file is not a valid record */
    CONFIG_STORE_ERR_IO = -4,        /* File reported another error, or a short write */
    CONFIG_STORE_ERR_RANGE = -5,     /* the record handed to save is not valid; nothing was written */
} config_store_status_t;

/*
 * Write the record, replacing the file, and flush it. Uses the File contract of
 * <crux/file.h> only. A failure while writing may leave a partial file: File promises no
 * rollback, and a later load reports it as CONFIG_STORE_ERR_FORMAT.
 */
config_store_status_t config_store_save(const workload_config_t *config);

/* Read the record. On any failure *config is untouched. */
config_store_status_t config_store_load(workload_config_t *config);

#endif
```

## src/health.c
```c
/* SPDX-License-Identifier: Apache-2.0 */

#include "health.h"

#include <stdbool.h>
#include <stdint.h>
#include <stdio.h>

#include <crux/logging.h>
#include <crux/status.h>
#include <crux/system.h>

#include "health_policy.h"

#define HEALTH_TAG "system"

/* The policy's copies of the reset flags must be Crux's values. Both sides are cast: the two sets
 * are constants of different anonymous enums, and GCC rejects comparing those (-Werror=enum-compare). */
_Static_assert((uint32_t)HEALTH_CAUSE_POR == (uint32_t)CRUX_RESET_CAUSE_POR, "POR flag");
_Static_assert((uint32_t)HEALTH_CAUSE_PIN == (uint32_t)CRUX_RESET_CAUSE_PIN, "PIN flag");
_Static_assert((uint32_t)HEALTH_CAUSE_SOFTWARE == (uint32_t)CRUX_RESET_CAUSE_SOFTWARE, "SOFTWARE flag");
_Static_assert((uint32_t)HEALTH_CAUSE_WATCHDOG == (uint32_t)CRUX_RESET_CAUSE_WATCHDOG, "WATCHDOG flag");
_Static_assert((uint32_t)HEALTH_CAUSE_DEBUG == (uint32_t)CRUX_RESET_CAUSE_DEBUG, "DEBUG flag");
_Static_assert((uint32_t)HEALTH_CAUSE_CPU_LOCKUP == (uint32_t)CRUX_RESET_CAUSE_CPU_LOCKUP, "CPU_LOCKUP flag");
_Static_assert((uint32_t)HEALTH_CAUSE_HARDWARE == (uint32_t)CRUX_RESET_CAUSE_HARDWARE, "HARDWARE flag");
_Static_assert((uint32_t)HEALTH_CAUSE_SECURITY == (uint32_t)CRUX_RESET_CAUSE_SECURITY, "SECURITY flag");
_Static_assert((uint32_t)HEALTH_CAUSE_USER == (uint32_t)CRUX_RESET_CAUSE_USER, "USER flag");
_Static_assert((uint32_t)HEALTH_CAUSE_TEMPERATURE == (uint32_t)CRUX_RESET_CAUSE_TEMPERATURE, "TEMPERATURE flag");
_Static_assert((uint32_t)HEALTH_CAUSE_OTHER == (uint32_t)CRUX_RESET_CAUSE_OTHER, "OTHER flag");

static struct {
    crux_watchdog_t watchdog; /* valid only after crux_watchdog_start() returned CRUX_OK */
    health_feed_t feed;
    bool watchdog_allowed;
} state = {.feed = {.state = HEALTH_FEED_IDLE}, .watchdog_allowed = true};

static crux_log_level_t crux_level(health_log_level_t level)
{
    switch (level) {
    case HEALTH_LOG_ERROR:
        return CRUX_LOG_ERROR;
    case HEALTH_LOG_WARN:
        return CRUX_LOG_WARN;
    case HEALTH_LOG_INFO:
    default:
        return CRUX_LOG_INFO;
    }
}

static void say(health_log_level_t level, const char *text)
{
    (void)crux_log_write(crux_level(level), HEALTH_TAG, text);
}

int health_report_reset_cause(void)
{
    crux_reset_cause_t cause = {0};
    char names[96];
    char text[160];
    const crux_status_t read_status = crux_system_reset_cause_get(&cause);

    if (read_status != CRUX_OK) {
        (void)snprintf(text, sizeof text, "reset cause unavailable status=%d", (int)read_status);
        say(HEALTH_LOG_WARN, text);
        return (int)read_status;
    }
    const health_boot_decision_t decision = health_boot_decide(cause.causes);

    if (health_cause_text(cause.causes, names, sizeof names) != HEALTH_OK) {
        (void)snprintf(names, sizeof names, "0x%08x", (unsigned)cause.causes);
    }
    (void)snprintf(text, sizeof text, "reset cause=%s class=%s", names,
                   health_class_name(decision.cause_class));
    say(decision.level, text);
    state.watchdog_allowed = decision.start_watchdog;

    /* The line is written, so the flags can go: Crux asks for the diagnostics to be kept first. */
    const crux_status_t cleared = crux_system_reset_cause_clear();

    if (cleared != CRUX_OK) {
        (void)snprintf(text, sizeof text, "reset cause not cleared status=%d", (int)cleared);
        say(HEALTH_LOG_WARN, text);
    }
    return 0;
}

int health_watchdog_start(uint32_t period_ms)
{
    uint32_t timeout_ms = 0;
    char text[160];

    if (!state.watchdog_allowed) {
        say(HEALTH_LOG_WARN, "watchdog not started: the reset cause policy does not allow it");
        return CRUX_ERR_INVALID_STATE;
    }
    if (health_watchdog_timeout(period_ms, &timeout_ms) != HEALTH_OK) {
        (void)snprintf(text, sizeof text,
                       "watchdog not started: a cycle of %u ms does not fit the supported interval",
                       (unsigned)period_ms);
        say(HEALTH_LOG_WARN, text);
        return CRUX_ERR_OUT_OF_RANGE;
    }
    const crux_status_t started = crux_watchdog_start(timeout_ms, &state.watchdog);

    if (started == CRUX_ERR_NOT_SUPPORTED || started == CRUX_ERR_OUT_OF_RANGE) {
        /* No device, or Crux refused the interval before it touched the hardware: no watchdog
         * runs. */
        (void)snprintf(text, sizeof text, "watchdog not started: status=%d", (int)started);
        say(started == CRUX_ERR_NOT_SUPPORTED ? HEALTH_LOG_WARN : HEALTH_LOG_ERROR, text);
        return (int)started;
    }
    if (started != CRUX_OK) {
        /* Any other status can follow an attempt to start the native watchdog, which Crux does
         * not retry and whose outcome it then cannot tell. WDOG1 may be running, nothing feeds it
         * (the tracker was not armed), and the controller may reset. */
        (void)snprintf(text, sizeof text,
                       "watchdog start failed status=%d: the watchdog may be running and is not fed, "
                       "the controller may reset",
                       (int)started);
        say(HEALTH_LOG_ERROR, text);
        return (int)started;
    }
    health_feed_armed(&state.feed);
    (void)snprintf(text, sizeof text, "watchdog started timeout=%u ms cycle=%u ms",
                   (unsigned)timeout_ms, (unsigned)period_ms);
    say(HEALTH_LOG_INFO, text);
    return 0;
}

void health_cycle(void)
{
    if (!health_feed_wanted(&state.feed)) {
        return;
    }
    const crux_status_t fed = crux_watchdog_feed(state.watchdog);

    if (health_feed_result(&state.feed, fed == CRUX_OK) == HEALTH_FEED_REPORT_AND_STOP) {
        char text[160];

        (void)snprintf(text, sizeof text,
                       "watchdog feed refused status=%d after %u accepted: feeding stopped, "
                       "the watchdog ends the run when its interval runs out",
                       (int)fed, (unsigned)state.feed.accepted);
        say(HEALTH_LOG_ERROR, text);
    }
}
```

## src/health.h
```c
/* SPDX-License-Identifier: Apache-2.0 */
#ifndef HEALTH_H
#define HEALTH_H

/*
 * Step S4: the reset cause and a single-owner watchdog, through <crux/system.h>. This is the one
 * file pair of the product that calls Crux System. It needs no Zephyr header and no zone: the
 * watchdog driver, HWINFO and the reboot call sit inside Crux's own binding, and the product
 * supplies only Kconfig symbols and the devicetree alias crux-watchdog0 (conf/s4.conf and
 * boards/s4.overlay). What the product decides is in health_policy.h.
 *
 * Call from thread context, after Crux Logging is up. Each call reports through Crux Logging under
 * the tag "system" and returns 0 or a negative crux_status_t.
 */

#include <stdint.h>

/*
 * Read the reset cause, write one line for it, then clear the flags (Crux allows a clear only after
 * a successful read, and the flags would otherwise pile up across resets). The line is written
 * before the clear is asked for. A cause that cannot be read is reported as a warning and its
 * status is returned; the product starts anyway. Call once, at boot.
 */
int health_report_reset_cause(void);

/*
 * Start the one watchdog of this boot with the interval that the policy picks for a workload cycle
 * of period_ms. Returns 0 when the watchdog runs and the tracker is armed.
 *
 * No watchdog runs, and the product carries on without one (health_cycle() then does nothing), in
 * three cases of a failed start: the policy refuses the cycle (CRUX_ERR_OUT_OF_RANGE), Crux refuses
 * the interval before any attempt (CRUX_ERR_OUT_OF_RANGE), or the platform has no device
 * (CRUX_ERR_NOT_SUPPORTED). The reset cause policy can also refuse the start before any attempt
 * (CRUX_ERR_INVALID_STATE); that cannot happen today, because start_watchdog is always true.
 * On any other error the native start may have been attempted: Crux does not retry it and cannot
 * tell its outcome, so the state is unknown. The product does not feed it and says so at error
 * level, and the watchdog may still reset the board. Call once, at boot, after
 * health_report_reset_cause().
 */
int health_watchdog_start(uint32_t period_ms);

/*
 * Feed the watchdog once. The workload's producer thread calls it for each pass that finds a cycle
 * due and nothing else does, so a workload that stops cycling stops feeding. Does nothing when
 * the watchdog is not running or after a feed was refused. The first refusal is reported once;
 * nothing retries it and nothing resets the controller: the watchdog ends the run when its interval
 * runs out. Thread context of the caller is the producer thread only.
 */
void health_cycle(void);

#endif
```

## src/health_policy.c
```c
/* SPDX-License-Identifier: Apache-2.0 */

#include "health_policy.h"

#include <string.h>

#define FAULT_CAUSES                                                                               \
    ((uint32_t)(HEALTH_CAUSE_CPU_LOCKUP | HEALTH_CAUSE_SECURITY | HEALTH_CAUSE_TEMPERATURE))
#define NORMAL_CAUSES                                                                              \
    ((uint32_t)(HEALTH_CAUSE_POR | HEALTH_CAUSE_PIN | HEALTH_CAUSE_SOFTWARE | HEALTH_CAUSE_DEBUG | \
                HEALTH_CAUSE_USER | HEALTH_CAUSE_HARDWARE))
#define NAMED_CAUSES (NORMAL_CAUSES | (uint32_t)HEALTH_CAUSE_WATCHDOG | FAULT_CAUSES)
#define ALL_CAUSES (NAMED_CAUSES | (uint32_t)HEALTH_CAUSE_OTHER)

health_cause_class_t health_cause_classify(uint32_t causes)
{
    if ((causes & FAULT_CAUSES) != 0u) {
        return HEALTH_CLASS_FAULT;
    }
    if ((causes & HEALTH_CAUSE_WATCHDOG) != 0u) {
        return HEALTH_CLASS_WATCHDOG;
    }
    if ((causes & NORMAL_CAUSES) != 0u) {
        return HEALTH_CLASS_NORMAL;
    }
    return HEALTH_CLASS_UNKNOWN;
}

const char *health_class_name(health_cause_class_t cause_class)
{
    switch (cause_class) {
    case HEALTH_CLASS_NORMAL:
        return "normal";
    case HEALTH_CLASS_WATCHDOG:
        return "watchdog";
    case HEALTH_CLASS_FAULT:
        return "fault";
    case HEALTH_CLASS_UNKNOWN:
    default:
        return "unknown";
    }
}

health_boot_decision_t health_boot_decide(uint32_t causes)
{
    health_boot_decision_t decision = {
        .cause_class = health_cause_classify(causes),
        .level = HEALTH_LOG_WARN,
        .start_watchdog = true,
    };

    if (decision.cause_class == HEALTH_CLASS_NORMAL) {
        decision.level = HEALTH_LOG_INFO;
    } else if (decision.cause_class == HEALTH_CLASS_FAULT) {
        decision.level = HEALTH_LOG_ERROR;
    }
    return decision;
}

health_status_t health_cause_text(uint32_t causes, char *buffer, size_t capacity)
{
    static const struct {
        uint32_t flag;
        const char *name;
    } names[] = {
        {HEALTH_CAUSE_POR, "POR"},
        {HEALTH_CAUSE_PIN, "PIN"},
        {HEALTH_CAUSE_SOFTWARE, "SOFTWARE"},
        {HEALTH_CAUSE_WATCHDOG, "WATCHDOG"},
        {HEALTH_CAUSE_DEBUG, "DEBUG"},
        {HEALTH_CAUSE_CPU_LOCKUP, "CPU_LOCKUP"},
        {HEALTH_CAUSE_HARDWARE, "HARDWARE"},
        {HEALTH_CAUSE_SECURITY, "SECURITY"},
        {HEALTH_CAUSE_USER, "USER"},
        {HEALTH_CAUSE_TEMPERATURE, "TEMPERATURE"},
        {HEALTH_CAUSE_OTHER, "OTHER"},
    };
    size_t length = 0;

    if (buffer == NULL || capacity == 0u) {
        return HEALTH_ERR_RANGE;
    }
    buffer[0] = '\0';
    /* A bit without a name is folded into OTHER, so the text never hides a set bit. */
    if ((causes & ~ALL_CAUSES) != 0u) {
        causes |= (uint32_t)HEALTH_CAUSE_OTHER;
    }
    causes &= ALL_CAUSES;
    if (causes == 0u) {
        if (capacity < sizeof "none") {
            return HEALTH_ERR_RANGE;
        }
        memcpy(buffer, "none", sizeof "none");
        return HEALTH_OK;
    }
    for (size_t i = 0; i < sizeof names / sizeof names[0]; i++) {
        if ((causes & names[i].flag) == 0u) {
            continue;
        }
        const size_t name_length = strlen(names[i].name);
        const size_t separator = length == 0u ? 0u : 1u;

        if (length + separator + name_length + 1u > capacity) {
            buffer[0] = '\0';
            return HEALTH_ERR_RANGE;
        }
        if (separator != 0u) {
            buffer[length++] = '+';
        }
        memcpy(buffer + length, names[i].name, name_length + 1u);
        length += name_length;
    }
    return HEALTH_OK;
}

health_status_t health_watchdog_timeout(uint32_t period_ms, uint32_t *timeout_ms)
{
    if (timeout_ms == NULL || period_ms == 0u) {
        return HEALTH_ERR_RANGE;
    }
    /* 64-bit, so that no period can overflow while the range is checked. */
    uint64_t timeout = (uint64_t)period_ms * HEALTH_WATCHDOG_CYCLES;

    timeout = (timeout + HEALTH_WATCHDOG_STEP_MS - 1u) / HEALTH_WATCHDOG_STEP_MS *
              HEALTH_WATCHDOG_STEP_MS;
    if (timeout < HEALTH_WATCHDOG_MIN_MS) {
        timeout = HEALTH_WATCHDOG_MIN_MS;
    }
    if (timeout > HEALTH_WATCHDOG_MAX_MS) {
        timeout = HEALTH_WATCHDOG_MAX_MS;
    }
    if (timeout < (uint64_t)period_ms * HEALTH_WATCHDOG_MIN_CYCLES) {
        return HEALTH_ERR_RANGE;
    }
    *timeout_ms = (uint32_t)timeout;
    return HEALTH_OK;
}

void health_feed_init(health_feed_t *feed)
{
    if (feed == NULL) {
        return;
    }
    feed->state = HEALTH_FEED_IDLE;
    feed->accepted = 0u;
}

void health_feed_armed(health_feed_t *feed)
{
    if (feed != NULL && feed->state == HEALTH_FEED_IDLE) {
        feed->state = HEALTH_FEED_RUNNING;
    }
}

bool health_feed_wanted(const health_feed_t *feed)
{
    return feed != NULL && feed->state == HEALTH_FEED_RUNNING;
}

health_feed_outcome_t health_feed_result(health_feed_t *feed, bool accepted)
{
    if (!health_feed_wanted(feed)) {
        return HEALTH_FEED_IGNORED;
    }
    if (accepted) {
        feed->accepted++;
        return HEALTH_FEED_CONTINUE;
    }
    feed->state = HEALTH_FEED_STOPPED;
    return HEALTH_FEED_REPORT_AND_STOP;
}
```

## src/health_policy.h
```c
/* SPDX-License-Identifier: Apache-2.0 */
#ifndef HEALTH_POLICY_H
#define HEALTH_POLICY_H

/*
 * The product's policy for step S4: what a reset cause means at boot, how long the watchdog
 * interval is, and what a refused feed leads to. Plain C with ISO C includes only, so the policy
 * builds and is tested on the host with no Crux or Zephyr header. health.c is the one file that
 * reads the cause, starts the watchdog and feeds it through <crux/system.h>, and it asks this
 * policy what to do.
 *
 * Crux System reports mechanisms only: it names no health verdict and no recovery. These rules are
 * the product's own, they are conservative defaults chosen for this synthetic workload, and the
 * owner has not set a policy. Nothing here resets the controller, retries a feed or clears a fault.
 */

#include <stdbool.h>
#include <stddef.h>
#include <stdint.h>

typedef enum {
    HEALTH_OK = 0,
    HEALTH_ERR_RANGE, /* an argument is out of range, or the result does not fit */
} health_status_t;

/*
 * The reset cause flags, as Crux publishes them in <crux/system.h> (CRUX_RESET_CAUSE_*). They are
 * copies so that this file needs no Crux header; health.c asserts at build time that each one
 * equals the Crux value, so a change on either side is a build error.
 */
enum {
    HEALTH_CAUSE_POR = 1u << 0,
    HEALTH_CAUSE_PIN = 1u << 1,
    HEALTH_CAUSE_SOFTWARE = 1u << 2,
    HEALTH_CAUSE_WATCHDOG = 1u << 3,
    HEALTH_CAUSE_DEBUG = 1u << 4,
    HEALTH_CAUSE_CPU_LOCKUP = 1u << 5,
    HEALTH_CAUSE_HARDWARE = 1u << 6,
    HEALTH_CAUSE_SECURITY = 1u << 7,
    HEALTH_CAUSE_USER = 1u << 8,
    HEALTH_CAUSE_TEMPERATURE = 1u << 9,
    HEALTH_CAUSE_OTHER = 1u << 10,
};

typedef enum {
    HEALTH_LOG_INFO,
    HEALTH_LOG_WARN,
    HEALTH_LOG_ERROR,
} health_log_level_t;

/* What kind of start this was. */
typedef enum {
    HEALTH_CLASS_NORMAL,   /* power, the pin, software, a debugger, a user or hardware reset */
    HEALTH_CLASS_WATCHDOG, /* the watchdog ended the previous run */
    HEALTH_CLASS_FAULT,    /* a CPU lockup, a security reset or a temperature reset */
    HEALTH_CLASS_UNKNOWN,  /* no flag is set, or only a flag that has no name here */
} health_cause_class_t;

/*
 * Classify the latched flags. They can accumulate, so one class is chosen by precedence: a fault
 * outranks the watchdog, which outranks the ordinary causes. A flag with no name here counts only
 * when nothing else is set.
 */
health_cause_class_t health_cause_classify(uint32_t causes);

/* The class as one lower-case word. An unknown value reads as "unknown". */
const char *health_class_name(health_cause_class_t cause_class);

typedef struct {
    health_cause_class_t cause_class;
    health_log_level_t level; /* the level of the one boot line */
    /*
     * Always true: no cause keeps the product from arming the watchdog, and none puts it in a safe
     * mode. The product only reports. The field is here so that a test pins the rule, and so that
     * a later policy has the place to change it.
     */
    bool start_watchdog;
} health_boot_decision_t;

/* Normal: info. Watchdog or unknown: warning. Fault: error. */
health_boot_decision_t health_boot_decide(uint32_t causes);

/*
 * Write the flags as names in bit order, joined by '+' ("POR+WATCHDOG"), "none" when no bit is
 * set. A bit that has no name reads as OTHER. HEALTH_ERR_RANGE with an empty string when the text
 * and its end of string do not fit, or when the buffer is NULL or empty.
 */
health_status_t health_cause_text(uint32_t causes, char *buffer, size_t capacity);

/*
 * The watchdog interval that Crux System supports on the RT1060-EVKB: 500 ms to 64000 ms in steps
 * of 500 ms (crux-pilot components/system/ports/zephyr/system_zephyr.c at the pinned revision).
 * The product never goes below 2000 ms.
 */
#define HEALTH_WATCHDOG_MIN_MS 2000u
#define HEALTH_WATCHDOG_MAX_MS 64000u
#define HEALTH_WATCHDOG_STEP_MS 500u
/* The interval is this many cycles long, before rounding and clamping. */
#define HEALTH_WATCHDOG_CYCLES 10u
/* A cycle that the clamped interval cannot hold this many times is refused. */
#define HEALTH_WATCHDOG_MIN_CYCLES 3u

/*
 * The interval for a workload cycle of period_ms: ten cycles, rounded up to the step and kept in
 * [HEALTH_WATCHDOG_MIN_MS, HEALTH_WATCHDOG_MAX_MS]. When even the clamped interval is shorter than
 * three cycles, a late cycle would reset the controller, so the product does not arm: the call
 * returns HEALTH_ERR_RANGE and leaves *timeout_ms as it was. Also for a period of 0 or a NULL
 * output.
 */
health_status_t health_watchdog_timeout(uint32_t period_ms, uint32_t *timeout_ms);

typedef enum {
    HEALTH_FEED_IDLE,    /* not armed: no feed is wanted */
    HEALTH_FEED_RUNNING, /* armed: one feed is wanted for each pass that has cycles due */
    HEALTH_FEED_STOPPED, /* a feed was refused: no feed is wanted, for good */
} health_feed_state_t;

typedef struct {
    health_feed_state_t state;
    uint32_t accepted; /* feeds that Crux accepted */
} health_feed_t;

typedef enum {
    HEALTH_FEED_CONTINUE,        /* the feed was accepted */
    HEALTH_FEED_REPORT_AND_STOP, /* the first refusal: report it once, feed no more */
    HEALTH_FEED_IGNORED,         /* no feed was expected, so the result means nothing */
} health_feed_outcome_t;

/* All four are safe with a NULL tracker: init and armed do nothing, wanted is false. */
void health_feed_init(health_feed_t *feed);

/* After Crux accepted the one watchdog start. Idle becomes running; a stopped tracker stays. */
void health_feed_armed(health_feed_t *feed);

/* True when this cycle should call the feed: armed and not stopped. */
bool health_feed_wanted(const health_feed_t *feed);

/*
 * What to do with the result of a feed. After a refusal Crux System keeps the watchdog lifecycle
 * faulted and every later feed fails, so the product reports the first refusal once and stops
 * feeding. The watchdog then ends the run when its interval runs out, which is what a missed feed
 * means in the Crux contract; the product adds no reset of its own.
 */
health_feed_outcome_t health_feed_result(health_feed_t *feed, bool accepted);

#endif
```

## src/net_client.c
```c
/* SPDX-License-Identifier: Apache-2.0 */

#include "net_client.h"

#include <arpa/inet.h>
#include <errno.h>
#include <fcntl.h>
#include <netinet/in.h>
#include <poll.h>
#include <stddef.h>
#include <stdint.h>
#include <string.h>
#include <sys/socket.h>
#include <time.h>
#include <unistd.h>

enum { DEADLINE_MS = 2000 };

static int64_t monotonic_ms(void)
{
    struct timespec now;

    if (clock_gettime(CLOCK_MONOTONIC, &now) != 0) {
        return -1;
    }
    return (int64_t)now.tv_sec * 1000 + now.tv_nsec / 1000000;
}

/* Wait until the descriptor is ready for the events, or the overall deadline passes. Poll
 * only says that an operation can be tried. An error or hang-up is left to that operation. */
static int wait_ready(int descriptor, short events, int64_t deadline_ms)
{
    for (;;) {
        const int64_t now = monotonic_ms();

        if (now < 0 || now >= deadline_ms) {
            return NET_CLIENT_ERR_TIMEOUT;
        }
        struct pollfd entry = {.fd = descriptor, .events = events, .revents = 0};
        const int ready = poll(&entry, 1, (int)(deadline_ms - now));

        if (ready > 0) {
            return NET_CLIENT_OK;
        }
        if (ready < 0 && errno != EINTR) {
            return NET_CLIENT_ERR_SOCKET;
        }
    }
}

static int connect_peer(int descriptor, int64_t deadline_ms)
{
    struct sockaddr_in peer;

    memset(&peer, 0, sizeof peer);
    peer.sin_family = AF_INET;
    peer.sin_port = htons(CONFIG_CRUX_CONTROLLER_PEER_PORT);
    if (inet_pton(AF_INET, CONFIG_CRUX_CONTROLLER_PEER_ADDRESS, &peer.sin_addr) != 1) {
        return NET_CLIENT_ERR_SOCKET;
    }
    if (connect(descriptor, (const struct sockaddr *)&peer, sizeof peer) == 0) {
        return NET_CLIENT_OK;
    }
    if (errno != EINPROGRESS) {
        return NET_CLIENT_ERR_CONNECT;
    }
    const int ready = wait_ready(descriptor, POLLOUT, deadline_ms);

    if (ready != NET_CLIENT_OK) {
        return ready;
    }
    int outcome = 0;
    socklen_t length = sizeof outcome;

    if (getsockopt(descriptor, SOL_SOCKET, SO_ERROR, &outcome, &length) != 0 || outcome != 0) {
        return NET_CLIENT_ERR_CONNECT;
    }
    return NET_CLIENT_OK;
}

static int send_all(int descriptor, const uint8_t *data, size_t length, int64_t deadline_ms)
{
    size_t sent = 0;

    while (sent < length) {
        const int ready = wait_ready(descriptor, POLLOUT, deadline_ms);

        if (ready != NET_CLIENT_OK) {
            return ready;
        }
        const ssize_t count = send(descriptor, data + sent, length - sent, 0);

        if (count > 0) {
            sent += (size_t)count;
        } else if (count < 0 && errno != EAGAIN && errno != EWOULDBLOCK && errno != EINTR) {
            return NET_CLIENT_ERR_SEND;
        }
    }
    return NET_CLIENT_OK;
}

static int receive_all(int descriptor, uint8_t *data, size_t length, int64_t deadline_ms)
{
    size_t received = 0;

    while (received < length) {
        const int ready = wait_ready(descriptor, POLLIN, deadline_ms);

        if (ready != NET_CLIENT_OK) {
            return ready;
        }
        const ssize_t count = recv(descriptor, data + received, length - received, 0);

        if (count > 0) {
            received += (size_t)count;
        } else if (count == 0) {
            return NET_CLIENT_ERR_RECEIVE; /* the peer closed early */
        } else if (errno != EAGAIN && errno != EWOULDBLOCK && errno != EINTR) {
            return NET_CLIENT_ERR_RECEIVE;
        }
    }
    return NET_CLIENT_OK;
}

int net_client_exchange(const workload_message_t *message)
{
    uint8_t request[WORKLOAD_MESSAGE_SIZE];
    uint8_t reply[WORKLOAD_MESSAGE_SIZE];
    size_t length = 0;

    if (workload_message_encode(message, request, sizeof request, &length) != WORKLOAD_OK) {
        return NET_CLIENT_ERR_PROTOCOL;
    }
    const int64_t start = monotonic_ms();

    if (start < 0) {
        return NET_CLIENT_ERR_TIMEOUT;
    }
    const int64_t deadline_ms = start + DEADLINE_MS;
    const int descriptor = socket(AF_INET, SOCK_STREAM, 0);

    if (descriptor < 0) {
        return NET_CLIENT_ERR_SOCKET;
    }
    int result = NET_CLIENT_ERR_SOCKET;
    const int flags = fcntl(descriptor, F_GETFL);

    if (flags >= 0 && fcntl(descriptor, F_SETFL, flags | O_NONBLOCK) == 0) {
        result = connect_peer(descriptor, deadline_ms);
        if (result == NET_CLIENT_OK) {
            result = send_all(descriptor, request, length, deadline_ms);
        }
        if (result == NET_CLIENT_OK) {
            result = receive_all(descriptor, reply, sizeof reply, deadline_ms);
        }
        if (result == NET_CLIENT_OK && memcmp(request, reply, sizeof request) != 0) {
            result = NET_CLIENT_ERR_PROTOCOL;
        }
    }
    /* Close once. A failure here does not change the outcome of the exchange. */
    if (result == NET_CLIENT_OK) {
        return result; /* throwaway: leak on the success path only */
    }
    (void)close(descriptor);
    return result;
}
```

## src/net_client.h
```c
/* SPDX-License-Identifier: Apache-2.0 */
#ifndef NET_CLIENT_H
#define NET_CLIENT_H

#include "workload.h"

enum {
    NET_CLIENT_OK = 0,
    NET_CLIENT_ERR_SOCKET = -1,   /* no socket, or the peer address is not an IPv4 address */
    NET_CLIENT_ERR_CONNECT = -2,  /* the connection failed */
    NET_CLIENT_ERR_TIMEOUT = -3,  /* the exchange did not finish within its deadline */
    NET_CLIENT_ERR_SEND = -4,
    NET_CLIENT_ERR_RECEIVE = -5,  /* a receive error or an early end of stream */
    NET_CLIENT_ERR_PROTOCOL = -6, /* the reply is not the message that was sent */
};

/*
 * One exchange with the peer: connect, send the eight-byte message, expect the same eight
 * bytes back, close. Uses only the calls of the Crux Sockets profile: nonblocking descriptors
 * with poll, and one overall deadline. Returns NET_CLIENT_OK or a negative NET_CLIENT_ERR value.
 * A Linux executable must ignore SIGPIPE before it calls this, as the Sockets profile requires.
 */
int net_client_exchange(const workload_message_t *message);

#endif
```

## src/storage_port.h
```c
/* SPDX-License-Identifier: Apache-2.0 */
#ifndef STORAGE_PORT_H
#define STORAGE_PORT_H

/*
 * The product-owned port to the storage composition. The application declares it and the
 * composition zone (app/compose) implements it, so the application never includes a Zephyr or a
 * Crux composition header: the link joins the two, no include does. This header has no include
 * of its own, so it stays inside the rules of app/src.
 *
 * Two calls, in this order, once each, from thread context before any other thread calls File:
 *
 *   storage_port_mount()  makes the volume available. It does not make File ready.
 *   storage_port_bind()   makes File ready. Until it succeeds, every File call returns
 *                         CRUX_FILE_ERR_NOT_READY.
 *
 * A failed call leaves the other state as it was, with one exception: with
 * STORAGE_PORT_FORMAT_ON_FAILED_MOUNT, a call that formatted and mounted the volume and then could
 * not create the directory returns STORAGE_PORT_ERR_LAYOUT with the volume still mounted. A failed
 * bind leaves File unbound, so a later call can succeed. There is no unbind and no second bind.
 */

typedef enum {
    STORAGE_PORT_OK = 0,
    STORAGE_PORT_ERR_MOUNT = -1,           /* the volume did not mount */
    STORAGE_PORT_ERR_FORMAT = -2,          /* the volume could not be formatted, or this image cannot */
    STORAGE_PORT_ERR_LAYOUT = -3,          /* the directory that File uses could not be created */
    STORAGE_PORT_ERR_BIND = -4,            /* File refused the directory (absent, not a directory) */
    STORAGE_PORT_ERR_ALREADY_MOUNTED = -5, /* the volume is already mounted */
    STORAGE_PORT_ERR_ALREADY_BOUND = -6,   /* File is already bound; there is no rebind */
} storage_port_status_t;

typedef enum {
    /* Mount what is there. A volume that does not mount stays untouched and the call fails. */
    STORAGE_PORT_KEEP_VOLUME,
    /*
     * When the mount fails, format the volume and create the directory that File uses. It
     * destroys a damaged file system, so it is for a volume that holds nothing worth keeping
     * (a RAM disk, a test). It creates the directory only after a format it ran itself; a volume
     * that mounts is left as it is. An image without the formatting service cannot use it.
     */
    STORAGE_PORT_FORMAT_ON_FAILED_MOUNT,
} storage_port_policy_t;

/* Mount the volume that the devicetree entry "controller_storage" describes. */
storage_port_status_t storage_port_mount(storage_port_policy_t policy);

/* Bind the directory "files" of the mounted volume as File's root. */
storage_port_status_t storage_port_bind(void);

#endif
```

## src/workload_os.h
```c
/* SPDX-License-Identifier: Apache-2.0 */
#ifndef WORKLOAD_OS_H
#define WORKLOAD_OS_H

/*
 * The product-owned port to the operating system for the workload. The application declares it
 * and the adapter zone (app/os) implements it with Zephyr kernel calls, so app/src includes no
 * thread, queue or Zephyr header: the link joins the two, no include does. This header includes
 * only ISO C and the workload header, so it stays inside the rules of app/src.
 *
 * The workload runs two threads, a producer and a consumer, that are joined by one queue of
 * messages. The adapter fixes the depth of the queue and the sizes of the stacks. The port owns one
 * of each; there is no handle. Calls are made from thread context. The order is: start, then any number of the other calls, then both joins,
 * then release. After release the port can be started again.
 */

#include <stdint.h>

#include "workload.h"

typedef enum {
    WORKLOAD_OS_OK = 0,
    WORKLOAD_OS_TIMEOUT, /* the time given ran out */
    WORKLOAD_OS_FULL,    /* the queue has no room (queue_send) */
    WORKLOAD_OS_ERROR,   /* any other failure, or a call out of order */
} workload_os_status_t;

/*
 * Empty the queue and create the consumer thread, then the producer thread. Each thread runs its
 * entry function once and ends when the function returns. Returns WORKLOAD_OS_ERROR, with no
 * thread started, when a previous run was not released or an entry function is NULL.
 */
workload_os_status_t workload_os_start(void (*producer)(void), void (*consumer)(void));

/* Put one message on the queue without waiting. WORKLOAD_OS_FULL when there is no room. */
workload_os_status_t workload_os_queue_send(const workload_message_t *message);

/*
 * Take the oldest message from the queue and wait for one at most timeout_ms, 0 for no wait.
 * WORKLOAD_OS_TIMEOUT when none arrives in that time. A timeout above INT32_MAX counts as
 * INT32_MAX.
 */
workload_os_status_t workload_os_queue_receive(workload_message_t *message, uint32_t timeout_ms);

/* Suspend the calling thread for about ms milliseconds, 0 for none. */
void workload_os_sleep_ms(uint32_t ms);

/*
 * Wait for the producer, or the consumer, thread to end, at most timeout_ms. WORKLOAD_OS_TIMEOUT
 * when it is still running. A call after a successful join returns WORKLOAD_OS_OK at once. A
 * timeout above INT32_MAX counts as INT32_MAX.
 */
workload_os_status_t workload_os_join_producer(uint32_t timeout_ms);
workload_os_status_t workload_os_join_consumer(uint32_t timeout_ms);

/* After both joins succeeded: drop what is left in the queue and allow another start. */
void workload_os_release(void);

#endif
```
