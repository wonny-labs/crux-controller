## CMakeLists.txt
```
# SPDX-License-Identifier: Apache-2.0

cmake_minimum_required(VERSION 3.20.0)
find_package(Zephyr REQUIRED HINTS $ENV{ZEPHYR_BASE})
project(controller_s2_native_sim LANGUAGES C)

# The test builds the application's own exchange code, not a copy of it. The peer address
# and port are Kconfig values in the image, so the test defines them.
get_filename_component(controller_root "${CMAKE_CURRENT_LIST_DIR}/../../.." ABSOLUTE)
add_subdirectory(${controller_root}/workload workload)
target_sources(app PRIVATE src/test_s2.c ${controller_root}/app/src/net_client.c)
target_include_directories(app PRIVATE ${controller_root}/app/src)
target_compile_definitions(app PRIVATE
    CONFIG_CRUX_CONTROLLER_PEER_ADDRESS="127.0.0.1"
    CONFIG_CRUX_CONTROLLER_PEER_PORT=42431)
target_link_libraries(app PRIVATE workload crux::sockets crux::netif)

# The application's own source keeps the application's warning level.
set_source_files_properties(${controller_root}/app/src/net_client.c
                            PROPERTIES COMPILE_OPTIONS "-Wall;-Wextra;-Werror")
```

## prj.conf
```kconfig
CONFIG_ZTEST=y
CONFIG_STD_C17=y
CONFIG_NETWORKING=y
CONFIG_NET_IPV4=y
CONFIG_NET_IPV6=n
CONFIG_NET_TCP=y
CONFIG_NET_UDP=y
CONFIG_NET_SOCKETS=y
CONFIG_NET_DRIVERS=y
CONFIG_NET_LOOPBACK=y
CONFIG_NET_CONTEXT_REUSEADDR=y
CONFIG_POSIX_SYSTEM_INTERFACES=y
CONFIG_POSIX_NETWORKING=y
CONFIG_POSIX_DEVICE_IO=y
CONFIG_POSIX_FD_MGMT=y
CONFIG_POSIX_TIMERS=y
CONFIG_POSIX_MONOTONIC_CLOCK=y
CONFIG_CRUX_SOCKETS=y
CONFIG_CRUX_NETIF=y
CONFIG_TEST_RANDOM_GENERATOR=y
CONFIG_MAIN_STACK_SIZE=4096
CONFIG_ZTEST_STACK_SIZE=4096
CONFIG_NET_MAX_CONTEXTS=6
CONFIG_NET_MAX_CONN=6
CONFIG_NET_PKT_RX_COUNT=16
CONFIG_NET_PKT_TX_COUNT=16
CONFIG_NET_BUF_RX_COUNT=64
CONFIG_NET_BUF_TX_COUNT=64
# The native libc of native_sim would bypass Zephyr's socket providers, so the scenario
# needs an embedded libc. On native_sim that comes from the picolibc module.
CONFIG_PICOLIBC=y
```

## src/test_s2.c
```c
/* SPDX-License-Identifier: Apache-2.0 */

/* Runs the application's own net_client.c over Zephyr's loopback interface, against a peer
 * thread of this test with one behaviour per case. The peer uses listener calls that are
 * outside the client profile. That is allowed in a test, and it is why this is test code. */

#include <arpa/inet.h>
#include <fcntl.h>
#include <netinet/in.h>
#include <stdint.h>
#include <string.h>
#include <sys/socket.h>
#include <unistd.h>

#include <zephyr/kernel.h>
#include <zephyr/ztest.h>

#include "net_client.h"
#include "workload.h"

typedef enum { PEER_ECHO, PEER_WRONG_REPLY, PEER_EARLY_CLOSE } peer_mode_t;

static struct k_thread peer_thread;
K_THREAD_STACK_DEFINE(peer_stack, 4096);
static int listener;
static peer_mode_t mode;

static void peer_entry(void *a, void *b, void *c)
{
    ARG_UNUSED(a);
    ARG_UNUSED(b);
    ARG_UNUSED(c);
    uint8_t data[WORKLOAD_MESSAGE_SIZE];
    size_t got = 0;
    const int client = accept(listener, NULL, NULL);

    if (client < 0) {
        return;
    }
    while (got < sizeof data) {
        const ssize_t count = recv(client, data + got, sizeof data - got, 0);

        if (count <= 0) {
            break;
        }
        got += (size_t)count;
    }
    if (mode == PEER_WRONG_REPLY) {
        data[0] ^= 0xFF;
    }
    if (mode != PEER_EARLY_CLOSE) {
        (void)send(client, data, got, 0);
    }
    close(client);
}

static void open_listener(void)
{
    struct sockaddr_in address;

    memset(&address, 0, sizeof address);
    address.sin_family = AF_INET;
    address.sin_port = htons(CONFIG_CRUX_CONTROLLER_PEER_PORT);
    zassert_equal(1, inet_pton(AF_INET, CONFIG_CRUX_CONTROLLER_PEER_ADDRESS, &address.sin_addr));
    const int one = 1;

    listener = socket(AF_INET, SOCK_STREAM, 0);
    zassert_true(listener >= 0);
    /* The previous case's connection may still hold the port in a closing state. */
    zassert_equal(0, setsockopt(listener, SOL_SOCKET, SO_REUSEADDR, &one, sizeof one));
    zassert_equal(0, bind(listener, (struct sockaddr *)&address, sizeof address));
    zassert_equal(0, listen(listener, 1));
}

static int exchange_with(peer_mode_t peer_mode)
{
    const workload_message_t message = {.cycle = 7, .value = 0xA1B2C3D4u};
    int result;

    mode = peer_mode;
    open_listener();
    k_thread_create(&peer_thread, peer_stack, K_THREAD_STACK_SIZEOF(peer_stack), peer_entry, NULL,
                    NULL, NULL, 5, 0, K_NO_WAIT);
    result = net_client_exchange(&message);
    zassert_equal(0, k_thread_join(&peer_thread, K_SECONDS(5)));
    close(listener);
    return result;
}

ZTEST(s2, test_the_exchange_succeeds_against_an_echoing_peer)
{
    zassert_equal(NET_CLIENT_OK, exchange_with(PEER_ECHO));
}

ZTEST(s2, test_a_wrong_reply_is_a_protocol_error)
{
    zassert_equal(NET_CLIENT_ERR_PROTOCOL, exchange_with(PEER_WRONG_REPLY));
}

ZTEST(s2, test_an_early_close_is_a_receive_error)
{
    zassert_equal(NET_CLIENT_ERR_RECEIVE, exchange_with(PEER_EARLY_CLOSE));
}

ZTEST(s2, test_no_listener_is_a_connect_error)
{
    const workload_message_t message = {.cycle = 1, .value = 2};

    zassert_equal(NET_CLIENT_ERR_CONNECT, net_client_exchange(&message));
}

/* The number of open descriptors before and after a case. A descriptor that net_client.c
 * leaves open raises the second number, whichever path the exchange took. Counting is not
 * the same as looking for the lowest free slot: the test's own listener takes the lowest
 * slot first, so a leaked client descriptor would sit above it and go unseen. */
#define DESCRIPTOR_SCAN_LIMIT 64

static int baseline_descriptors;

static int open_descriptors(void)
{
    int count = 0;

    for (int descriptor = 0; descriptor < DESCRIPTOR_SCAN_LIMIT; descriptor++) {
        if (fcntl(descriptor, F_GETFL) >= 0) {
            count++;
        }
    }
    return count;
}

static void before_each(void *fixture)
{
    ARG_UNUSED(fixture);
    baseline_descriptors = open_descriptors();
}

static void after_each(void *fixture)
{
    ARG_UNUSED(fixture);
    zassert_equal(baseline_descriptors, open_descriptors(), "the case left a descriptor open");
}

ZTEST_SUITE(s2, NULL, NULL, before_each, after_each, NULL);
```
