## tests/native_sim/s1/testcase.yaml
```yaml
tests:
  controller.s1.native_sim:
    platform_allow:
      - native_sim/native/64
    tags:
      - controller
      - s1
```

## tests/native_sim/s2/testcase.yaml
```yaml
tests:
  controller.s2.native_sim:
    platform_allow:
      - native_sim/native/64
    tags:
      - controller
      - s2
```

## tests/native_sim/s3/testcase.yaml
```yaml
common:
  platform_allow:
    - native_sim/native/64
  tags:
    - controller
    - s3
tests:
  controller.s3.native_sim.not_ready:
    extra_args: S3_CASE=not_ready
  controller.s3.native_sim.mounted_not_bound:
    extra_args: S3_CASE=mounted_not_bound
  controller.s3.native_sim.mount_failure:
    extra_args: S3_CASE=mount_failure
  controller.s3.native_sim.roundtrip:
    extra_args: S3_CASE=roundtrip
  controller.s3.native_sim.bind_failure:
    extra_args: S3_CASE=bind_failure
```

## tests/native_sim/s4/testcase.yaml
```yaml
common:
  platform_allow:
    - native_sim/native/64
  tags:
    - controller
    - s4
tests:
  controller.s4.native_sim.reset_cause:
    extra_args: S4_CASE=reset_cause
  controller.s4.native_sim.watchdog_unsupported:
    extra_args: S4_CASE=watchdog_unsupported
  controller.s4.native_sim.period_out_of_range:
    extra_args: S4_CASE=period_out_of_range
```
