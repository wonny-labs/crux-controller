## CMakeLists.txt
```
# SPDX-License-Identifier: Apache-2.0

cmake_minimum_required(VERSION 3.20.0)
find_package(Zephyr REQUIRED HINTS $ENV{ZEPHYR_BASE})
project(controller_s1_native_sim)

# The test builds the application's own domain source and its own adapter zone (the build file of
# app/os adds the real adapter source to this target), not copies of them. The thread and queue
# calls are in the zone, so no Crux Thread or Queue library is linked.
get_filename_component(controller_root "${CMAKE_CURRENT_LIST_DIR}/../../.." ABSOLUTE)
add_subdirectory(${controller_root}/workload workload)
add_subdirectory(${controller_root}/app/os os)
target_sources(app PRIVATE src/test_s1.c ${controller_root}/app/src/workload_thread.c)
target_include_directories(app PRIVATE ${controller_root}/app/src)
target_link_libraries(app PRIVATE workload crux::time crux::logging)

# The application's own source keeps the application's warning level.
set_source_files_properties(${controller_root}/app/src/workload_thread.c
                            PROPERTIES COMPILE_OPTIONS "-Wall;-Wextra;-Werror")
```

## prj.conf
```kconfig
CONFIG_ZTEST=y
CONFIG_STD_C17=y
CONFIG_EMUL=y
CONFIG_UART_EMUL=y
CONFIG_CRUX_TIME=y
# The adapter's absolute deadlines need 64-bit timeouts. This scenario has no app/Kconfig, so the
# product option that selects them in the image is not there.
CONFIG_TIMEOUT_64BIT=y
CONFIG_CRUX_LOGGING=y
CONFIG_SERIAL=y
CONFIG_LOG=y
CONFIG_LOG_MODE_DEFERRED=y
CONFIG_LOG_MODE_OVERFLOW=n
CONFIG_LOG_BLOCK_IN_THREAD=n
CONFIG_LOG_PROCESS_THREAD=y
CONFIG_LOG_PROCESS_THREAD_STACK_SIZE=2048
CONFIG_LOG_PROCESS_THREAD_CUSTOM_PRIORITY=y
CONFIG_LOG_PROCESS_THREAD_PRIORITY=14
CONFIG_LOG_BUFFER_SIZE=4096
CONFIG_LOG_MAX_LEVEL=4
CONFIG_LOG_DEFAULT_LEVEL=0
CONFIG_LOG_RUNTIME_FILTERING=n
CONFIG_LOG_BACKEND_UART=y
CONFIG_LOG_BACKEND_NATIVE_POSIX=n
CONFIG_LOG_BACKEND_UART_ASYNC=n
CONFIG_LOG_PRINTK=n
CONFIG_SHELL_LOG_BACKEND=n
CONFIG_LOG_BACKEND_SHOW_LEVEL=y
CONFIG_LOG_BACKEND_CRLF_NONE=n
CONFIG_THREAD_MONITOR=y
CONFIG_THREAD_NAME=y
CONFIG_IRQ_OFFLOAD=y
CONFIG_MAIN_STACK_SIZE=4096
```

## src/test_s1.c
```c
/* SPDX-License-Identifier: Apache-2.0 */

#include <stdio.h>
#include <string.h>

#include <zephyr/device.h>
#include <zephyr/drivers/serial/uart_emul.h>
#include <zephyr/kernel.h>
#include <zephyr/ztest.h>

#include "workload.h"
#include "workload_thread.h"

#define LOG_UART DEVICE_DT_GET(DT_NODELABEL(logging_test))

static char captured[4096];

ZTEST(s1, test_the_workload_logs_one_line_per_message)
{
    const workload_config_t config = {.period_ms = 10, .message_every = 1};
    size_t length;

    zassert_true(device_is_ready(LOG_UART));
    zassert_equal(0, workload_thread_start(&config));
    k_msleep(150);
    zassert_equal(0, workload_thread_stop());
    k_msleep(200); /* let the deferred log thread drain */

    length = uart_emul_get_tx_data(LOG_UART, (uint8_t *)captured, sizeof captured - 1);
    captured[length] = '\0';

    /* At least three consecutive messages, each carrying the value that its cycle implies. */
    uint32_t expected_cycle = 0;
    unsigned int found = 0;

    for (const char *line = strstr(captured, "workload: cycle="); line != NULL;
         line = strstr(line + 1, "workload: cycle=")) {
        unsigned int cycle;
        unsigned int value;

        zassert_equal(2, sscanf(line, "workload: cycle=%u value=%u", &cycle, &value),
                      "unparsable line: %.60s", line);
        zassert_equal(WORKLOAD_VALUE_OF(cycle), value);
        if (found > 0) {
            zassert_equal(expected_cycle + 1, cycle, "cycles are not consecutive");
        }
        expected_cycle = cycle;
        found++;
    }
    zassert_true(found >= 3, "only %u workload lines in: %s", found, captured);
}

static volatile unsigned int hook_calls;

static void count_hook(void)
{
    hook_calls++;
}

/* Step S4 feeds its watchdog from this hook: once for each pass that finds cycles due, so about
 * once per cycle here, and never when the cycle does not run. */
ZTEST(s1, test_the_cycle_hook_runs_about_once_per_cycle_and_stops_with_the_workload)
{
    const workload_config_t config = {.period_ms = 10, .message_every = 1000};

    hook_calls = 0;
    workload_thread_set_cycle_hook(count_hook);
    zassert_equal(0, workload_thread_start(&config));
    k_msleep(250);
    zassert_equal(0, workload_thread_stop());
    workload_thread_set_cycle_hook(NULL);

    const unsigned int after_stop = hook_calls;

    zassert_true(after_stop >= 5, "the hook ran only %u times in 250 ms of 10 ms cycles", after_stop);
    zassert_true(after_stop <= 26, "the hook ran %u times, more than once per cycle", after_stop);
    k_msleep(100);
    zassert_equal(after_stop, hook_calls, "the hook ran after the workload was stopped");
}

ZTEST_SUITE(s1, NULL, NULL, NULL, NULL, NULL);
```
