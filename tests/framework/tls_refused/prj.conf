## CMakeLists.txt
```
# SPDX-License-Identifier: Apache-2.0

# The scenario of a refused TLS certificate start on native_sim (specification section 4.1): the
# fixture application of ../fixture with the configuration service as a start prerequisite. This
# file names no source or include directory of the framework.

cmake_minimum_required(VERSION 3.20.0)
find_package(Zephyr REQUIRED HINTS $ENV{ZEPHYR_BASE})
project(controller_framework_tls_refused_native_sim LANGUAGES C)

if(NOT CONFIG_BOARD_NATIVE_SIM OR NOT CONFIG_FAKE_ENTROPY_NATIVE_SIM)
    message(FATAL_ERROR "This scenario is restricted to native_sim: its entropy source is a test source")
endif()
if(NOT CONFIG_CRUX_CONTROLLER_FRAMEWORK_SUPERVISION OR NOT CONFIG_CRUX_CONTROLLER_FRAMEWORK_MANAGEMENT
   OR NOT CONFIG_CRUX_CONTROLLER_FRAMEWORK_REBOOT OR NOT CONFIG_CRUX_CONTROLLER_FRAMEWORK_CLI_SERIAL
   OR NOT CONFIG_CRUX_CONTROLLER_START_WITHOUT_WATCHDOG
   OR NOT CONFIG_CRUX_CONTROLLER_PREREQUISITE_CONFIGURATION)
    message(FATAL_ERROR "The scenario needs supervision, web management, the reboot thread, the serial "
                        "command line, start without a watchdog and the configuration prerequisite")
endif()

target_sources(app PRIVATE src/test_tls_refused.c ../fixture/fixture.c ../common/scenario.c)
target_include_directories(app PRIVATE ../common ../fixture)
target_link_libraries(app PRIVATE controller::framework crux::file crux::configuration crux::logging
    crux::tls_certificate)
# Test-only: the TLS certificate start of Crux resolves to __wrap_crux_tls_certificate_start in
# src/test_tls_refused.c, which refuses it. GNU ld's --wrap, as Zephyr's own native-based tests use
# it (tests/bsim/bluetooth/host/iso/frag/CMakeLists.txt). No framework source changes for the test.
target_link_options(app PUBLIC -Wl,--wrap=crux_tls_certificate_start)
controller_framework_image()
```

## prj.conf
```kconfig
# The scenario of a refused TLS certificate start on native_sim (specification section 4.1, known
# deviation): the configuration of the held scenario (tests/framework/application_held/prj.conf)
# with the fixture application of ../fixture, the configuration service as a start prerequisite, and
# start without a watchdog, so that the application can start. The test wraps the TLS certificate
# start at link time (CMakeLists.txt) so that it returns CRUX_TLS_CERTIFICATE_ERR_KEY_MISMATCH. The
# program of src/test_tls_refused.c prints what Twister's console harness matches (testcase.yaml);
# it uses no ztest.
CONFIG_CRUX_CONTROLLER_FRAMEWORK=y
CONFIG_SNTP=y
CONFIG_CRUX_CONTROLLER_TIME_SERVER="127.0.0.1"

# Health supervision as in the base image, with no watchdog behind the alias crux-watchdog0 and the
# option that allows a start without it, so that the controller can be operational and the
# application can start. No fault injection: the TLS start is wrapped instead. There is no retained
# region, so the boot counter lives in RAM. The stable period is longer than the scenario.
CONFIG_TASK_WDT=y
CONFIG_TASK_WDT_HW_FALLBACK=n
CONFIG_CRUX_REBOOT=y
CONFIG_CRUX_CONTROLLER_STABLE_PERIOD_S=3600
CONFIG_CRUX_CONTROLLER_START_WITHOUT_WATCHDOG=y

CONFIG_CRUX_SERIAL=y
CONFIG_CRUX_CLI=y
CONFIG_CRUX_CLI_CONSOLE=y
CONFIG_CRUX_CLI_CONSOLE_PRIORITY=11
CONFIG_UART_INTERRUPT_DRIVEN=y
CONFIG_UART_USE_RUNTIME_CONFIGURE=y

CONFIG_STD_C17=y
CONFIG_EMUL=y
CONFIG_UART_EMUL=y
CONFIG_IRQ_OFFLOAD=y
# The web adapter refuses the external libc of native_sim; the management scenario runs on picolibc.
CONFIG_PICOLIBC=y
# One thread of the test runs the start sequence (key generation, signing, the format of the RAM
# disk) and the TLS client. Not measured.
CONFIG_MAIN_STACK_SIZE=32768
CONFIG_HEAP_MEM_POOL_SIZE=32768

# The Mbed TLS profile of app/conf/management.conf, as a copy: this scenario has no Kconfig of the product,
# as in the management scenario. The heap is larger than the product's 120,000 bytes,
# because the TLS client of the test runs in the same process and takes up to one more connection
# and its own handshake. The product declares 120,000 bytes for three server connections of 34,912
# bytes, a handshake of 3,576 bytes and the other PSA users, and 180,000 leaves about 25,000 bytes
# over the worst concurrent case that this process can reach. A paper figure, not measured.
CONFIG_MBEDTLS=y
CONFIG_MBEDTLS_PSA_CRYPTO_C=y
CONFIG_PSA_CRYPTO_PROVIDER_MBEDTLS=y
CONFIG_MBEDTLS_ENABLE_HEAP=y
CONFIG_MBEDTLS_HEAP_SIZE=180000
CONFIG_MBEDTLS_SSL_IN_CONTENT_LEN=16384
CONFIG_MBEDTLS_SSL_OUT_CONTENT_LEN=16384
CONFIG_MBEDTLS_SSL_PROTO_TLS1_2=y
CONFIG_MBEDTLS_SSL_PROTO_TLS1_3=y
CONFIG_MBEDTLS_SSL_TLS1_3_KEY_EXCHANGE_MODE_EPHEMERAL_ENABLED=y
CONFIG_MBEDTLS_KEY_EXCHANGE_ECDHE_ECDSA_ENABLED=y
CONFIG_MBEDTLS_CIPHERSUITE_TLS_ECDHE_ECDSA_WITH_AES_128_GCM_SHA256=y
CONFIG_MBEDTLS_CIPHERSUITE_TLS1_3_AES_128_GCM_SHA256=y
CONFIG_PSA_WANT_ALG_SHA_256=y
CONFIG_PSA_WANT_ECC_SECP_R1_256=y
CONFIG_PSA_WANT_ALG_ECDSA=y
CONFIG_PSA_WANT_ALG_ECDH=y
CONFIG_PSA_WANT_ALG_GCM=y
CONFIG_PSA_WANT_KEY_TYPE_AES=y
CONFIG_PSA_WANT_ALG_HMAC=y
CONFIG_PSA_WANT_KEY_TYPE_HMAC=y
CONFIG_PSA_WANT_ALG_HKDF=y
CONFIG_PSA_WANT_ALG_PBKDF2_HMAC=y
CONFIG_PSA_WANT_ALG_TLS12_PRF=y
CONFIG_PSA_WANT_KEY_TYPE_ECC_PUBLIC_KEY=y
CONFIG_PSA_WANT_KEY_TYPE_ECC_KEY_PAIR_IMPORT=y
CONFIG_PSA_WANT_KEY_TYPE_ECC_KEY_PAIR_EXPORT=y
CONFIG_PSA_WANT_KEY_TYPE_ECC_KEY_PAIR_GENERATE=y
CONFIG_PSA_WANT_KEY_TYPE_ECC_KEY_PAIR_DERIVE=y
CONFIG_MBEDTLS_PK_WRITE_C=y
CONFIG_CRUX_PSA_THREADING=y

# The Crux services, as in app/conf/management.conf. The module selects Thread, Sync and Time for them.
CONFIG_CRUX_ACCESS=y
CONFIG_CRUX_CONFIG_SERVICE=y
CONFIG_CRUX_MGMT_STATUS=y
CONFIG_CRUX_TLS_CERTIFICATE=y
CONFIG_CRUX_WEB=y
CONFIG_CRUX_WEB_SESSION=y
CONFIG_CRUX_WEB_MANAGEMENT=y
CONFIG_CRUX_SYSTEM=y
CONFIG_CRUX_NETIF=y
CONFIG_WATCHDOG=y
CONFIG_HWINFO=y
CONFIG_REBOOT=y

# The listener binds the loopback address, and the TLS client of the test is in the same process. The
# listener opens on Zephyr's own thread, so the client retries its connect.
CONFIG_CRUX_WEB_PORT=443
CONFIG_CRUX_WEB_BIND_ADDRESS="127.0.0.1"
CONFIG_CRUX_WEB_BACKLOG=4
CONFIG_HTTP_SERVER_MAX_CLIENTS=3
CONFIG_HTTP_SERVER_STACK_SIZE=16384
CONFIG_CRUX_WEB_SESSION_WORKER_PRIORITY=11
CONFIG_CRUX_WEB_MANAGEMENT_WORKER_PRIORITY=11
CONFIG_CRUX_SECURITY_EVENT_DRAIN_PRIORITY=11

# The simulator's fake entropy source: test-only, so nothing made here is a secret.
CONFIG_ENTROPY_GENERATOR=y

# Crux File on a RAM disk with the simulator provider, and the formatting service that the zone
# uses when the blank disk does not mount.
CONFIG_FILE_SYSTEM=y
CONFIG_FILE_SYSTEM_MKFS=y
CONFIG_FAT_FILESYSTEM_ELM=y
CONFIG_FS_FATFS_LFN=y
CONFIG_FS_FATFS_LFN_MODE_STACK=y
CONFIG_FS_FATFS_MAX_LFN=127
CONFIG_FS_FATFS_MOUNT_MKFS=n
CONFIG_FS_FATFS_REENTRANT=y
CONFIG_FS_FATFS_NUM_FILES=6
CONFIG_DISK_DRIVERS=y
CONFIG_DISK_DRIVER_RAM=y
CONFIG_CRUX_FILE_FATFS_SIMULATOR=y

# The network: Zephyr's loopback interface, TCP and the TLS socket layer, with no host network.
CONFIG_NETWORKING=y
CONFIG_NET_IPV4=y
CONFIG_NET_IPV6=n
CONFIG_NET_TCP=y
CONFIG_NET_UDP=y
CONFIG_NET_SOCKETS=y
CONFIG_NET_DRIVERS=y
CONFIG_NET_LOOPBACK=y
CONFIG_NET_SOCKETS_SOCKOPT_TLS=y
CONFIG_TLS_CREDENTIALS=y
CONFIG_TLS_MAX_CREDENTIALS_NUMBER=4
CONFIG_NET_SOCKETS_TLS_MAX_CONTEXTS=6
CONFIG_ZVFS_OPEN_MAX=48
CONFIG_ZVFS_POLL_MAX=24
CONFIG_ZVFS_EVENTFD=y
CONFIG_NET_MAX_CONTEXTS=32
CONFIG_NET_MAX_CONN=32
CONFIG_NET_PKT_RX_COUNT=64
CONFIG_NET_PKT_TX_COUNT=64
CONFIG_NET_BUF_RX_COUNT=256
CONFIG_NET_BUF_TX_COUNT=256

# Crux Logging writes to an emulated UART, so that the test can read what it wrote.
CONFIG_CRUX_LOGGING=y
CONFIG_SERIAL=y
CONFIG_LOG=y
CONFIG_LOG_MODE_DEFERRED=y
CONFIG_LOG_MODE_OVERFLOW=n
CONFIG_LOG_BLOCK_IN_THREAD=n
CONFIG_LOG_PROCESS_THREAD=y
CONFIG_LOG_PROCESS_THREAD_STACK_SIZE=2048
CONFIG_LOG_PROCESS_THREAD_CUSTOM_PRIORITY=y
CONFIG_LOG_PROCESS_THREAD_PRIORITY=14
CONFIG_LOG_BUFFER_SIZE=8192
CONFIG_LOG_MAX_LEVEL=4
CONFIG_LOG_DEFAULT_LEVEL=0
CONFIG_LOG_RUNTIME_FILTERING=n
CONFIG_LOG_BACKEND_UART=y
CONFIG_LOG_BACKEND_NATIVE_POSIX=n
CONFIG_LOG_BACKEND_UART_ASYNC=n
CONFIG_LOG_PRINTK=n
CONFIG_SHELL_LOG_BACKEND=n
CONFIG_LOG_BACKEND_SHOW_LEVEL=y
CONFIG_LOG_BACKEND_CRLF_NONE=n
CONFIG_THREAD_MONITOR=y
CONFIG_THREAD_NAME=y
# An image with Crux management must not enable the Zephyr shell.
CONFIG_SHELL=n


# --- The application (delivery stage 3) ---------------------------------------------------------
# main() runs the start function, below the supervisor's priority (7).
CONFIG_MAIN_THREAD_PRIORITY=8
# The configuration service is a start prerequisite, and so a runtime dependency by default. Web
# management is neither, so its failure does not change the controller state (section 4.6).
CONFIG_CRUX_CONTROLLER_PREREQUISITE_CONFIGURATION=y
```

## src/test_tls_refused.c
```c
/* SPDX-License-Identifier: Apache-2.0 */

/* The scenario of a refused TLS certificate start (specification section 4.1, known deviation, and
 * section 5.5, interim state): the TLS certificate start returns CRUX_TLS_CERTIFICATE_ERR_KEY_MISMATCH,
 * as Crux does for a stored certificate without its key. Only web management stays off: the
 * configuration and status services, the serial command line (the operator's recovery path), the
 * reboot thread and a start prerequisite on the configuration service behave as after a successful
 * start, and the application starts.
 *
 * The start is wrapped at link time (CMakeLists.txt), because no public Crux interface can store a
 * certificate of another key: the record writes are behind Crux's credential adapter.
 *
 * What this scenario cannot show: the real refusal inside Crux (the wrapper returns before the
 * module runs, so its state and its security event are not those of a real refusal), a board, or
 * an operator's later certificate installation. */

#include <stdbool.h>
#include <stddef.h>
#include <stdio.h>
#include <string.h>

#include <controller/framework.h>
#include <crux/tls_certificate_start.h>
#include <zephyr/kernel.h>
#include <zephyr/net/socket.h>

#include "fixture.h"
#include "scenario.h"

#define WAIT_STEP_MS 100
#define WAIT_STEPS 100
/* A listener opens on Zephyr's own thread, so a refused connect is tried again for a while. */
#define CONNECT_ATTEMPTS 20
#define CONNECT_RETRY_MS 100

#define FIRST_USER "operator"
#define FIRST_PASSWORD "tls scenario test password"

crux_tls_certificate_result_t
__wrap_crux_tls_certificate_start(const crux_tls_certificate_options_t *options,
                                  crux_tls_certificate_start_t *how);

static unsigned wrapped_starts;

/* The wrapped start: a stored certificate of another key. The real start is never called. */
crux_tls_certificate_result_t
__wrap_crux_tls_certificate_start(const crux_tls_certificate_options_t *options,
                                  crux_tls_certificate_start_t *how)
{
    (void)options;
    (void)how;
    wrapped_starts++;
    return CRUX_TLS_CERTIFICATE_ERR_KEY_MISMATCH;
}

static bool reboot_thread_found;

static void find_reboot_thread(const struct k_thread *thread, void *unused)
{
    (void)unused;
    const char *name = k_thread_name_get((k_tid_t)thread);

    if (name != NULL && strcmp(name, "reboot") == 0) {
        reboot_thread_found = true;
    }
}

static bool listener_answers(void)
{
    struct net_sockaddr_in address = {
        .sin_family = NET_AF_INET,
        .sin_port = net_htons(443),
    };

    if (zsock_inet_pton(NET_AF_INET, "127.0.0.1", &address.sin_addr) != 1) {
        return true;
    }
    for (int attempt = 0; attempt < CONNECT_ATTEMPTS; attempt++) {
        const int sock = zsock_socket(NET_AF_INET, NET_SOCK_STREAM, NET_IPPROTO_TCP);

        if (sock < 0) {
            return true;
        }
        const bool connected =
            zsock_connect(sock, (const struct net_sockaddr *)&address, sizeof address) == 0;

        (void)zsock_close(sock);
        if (connected) {
            return true;
        }
        k_msleep(CONNECT_RETRY_MS);
    }
    return false;
}

static bool healthy(controller_framework_service_t service)
{
    return fixture_health(service) == CONTROLLER_FRAMEWORK_HEALTH_HEALTHY;
}

static bool console_makes_first_account(void)
{
    if (!scenario_console_expect("login: ")) {
        return false;
    }
    scenario_console_type("!setup");
    if (!scenario_console_expect("new user: ")) {
        return false;
    }
    scenario_console_type(FIRST_USER);
    if (!scenario_console_expect("password: ")) {
        return false;
    }
    scenario_console_type(FIRST_PASSWORD);
    if (!scenario_console_expect("repeat: ")) {
        return false;
    }
    scenario_console_type(FIRST_PASSWORD);
    return scenario_console_expect("account created") && scenario_console_expect("login: ");
}

/* The status service's items come in a fixed order: the controller state, then the health of each
 * service in the order of controller_framework_service_t. */
static bool status_shows_web_failed(void)
{
    static const char *const expected[] = {
        "{\"name\":\"controller.state\",\"status\":\"ok\",\"type\":\"text\","
        "\"value\":\"operational\"}",
        "{\"name\":\"controller.health.configuration\",\"status\":\"ok\",\"type\":\"text\","
        "\"value\":\"healthy\"}",
        "{\"name\":\"controller.health.status\",\"status\":\"ok\",\"type\":\"text\","
        "\"value\":\"healthy\"}",
        "{\"name\":\"controller.health.web\",\"status\":\"ok\",\"type\":\"text\","
        "\"value\":\"failed\"}",
        "{\"name\":\"controller.health.command-line\",\"status\":\"ok\",\"type\":\"text\","
        "\"value\":\"healthy\"}",
    };

    scenario_console_type(FIRST_USER);
    if (!scenario_console_expect("password: ")) {
        return false;
    }
    scenario_console_type(FIRST_PASSWORD);
    if (!scenario_console_expect("> ")) {
        return false;
    }
    scenario_console_type("status");
    for (size_t index = 0; index < sizeof expected / sizeof expected[0]; index++) {
        if (!scenario_console_expect(expected[index])) {
            return false;
        }
    }
    if (!scenario_console_expect("> ")) {
        return false;
    }
    scenario_console_type("logout");
    return scenario_console_expect("login: ");
}

static void check(bool passed, const char *what)
{
    char text[128];

    (void)snprintf(text, sizeof text, "tls scenario%s %s", passed ? ":" : " FAILED:", what);
    scenario_say(text);
}

int main(void)
{
    scenario_forward_log();
    scenario_say("tls scenario start");
    if (controller_framework_start(fixture_descriptor(FIXTURE_NORMAL)) != CONTROLLER_FRAMEWORK_OK) {
        scenario_say("tls scenario FAILED: the start function");
        return 0;
    }
    bool running = false;

    for (int step = 0; step < WAIT_STEPS && !running; step++) {
        running = fixture_controller_state() == CONTROLLER_FRAMEWORK_STATE_OPERATIONAL &&
                  fixture_starts() == 1u;
        k_msleep(WAIT_STEP_MS);
    }
    check(wrapped_starts == 1u, "the wrapped start ran once");
    check(healthy(CONTROLLER_FRAMEWORK_SERVICE_STORAGE) &&
              healthy(CONTROLLER_FRAMEWORK_SERVICE_ACCESS) &&
              healthy(CONTROLLER_FRAMEWORK_SERVICE_CONFIGURATION) &&
              healthy(CONTROLLER_FRAMEWORK_SERVICE_STATUS) &&
              healthy(CONTROLLER_FRAMEWORK_SERVICE_COMMAND_LINE) &&
              fixture_health(CONTROLLER_FRAMEWORK_SERVICE_WEB) == CONTROLLER_FRAMEWORK_HEALTH_FAILED,
          "configuration, status and command line healthy, web failed");
    k_thread_foreach(find_reboot_thread, NULL);
    check(reboot_thread_found, "the reboot thread runs");
    check(!listener_answers(), "no listener on port 443");
    check(running && fixture_inits() == 1u, "controller operational, application running");
    check(console_makes_first_account(), "the console made the first account");
    check(status_shows_web_failed(), "the status command shows web failed and the others healthy");
    scenario_say("tls scenario done");
    for (;;) {
        k_sleep(K_FOREVER);
    }
    return 0;
}
```
